## drivers/video/Kconfig.ov5640
```kconfig
# OV5640

# Copyright 2024 NXP
# SPDX-License-Identifier: Apache-2.0

config VIDEO_OV5640
	bool "OV5640 CMOS digital image sensor"
	select I2C
	depends on DT_HAS_OVTI_OV5640_ENABLED
	default y
	help
	  Enable driver for OV5640 CMOS digital image sensor device

config VIDEO_OV5640
	bool "OV5640 CMOS digital image sensor"
	select I2C
	depends on DT_HAS_OVTI_OV5640_ENABLED
	default y
	help
	  Enable driver for OV5640 CMOS digital image sensor device

config VIDEO_OV5640_DEFAULT_WIDTH
	int "OV5640 default frame width in pixels"
	depends on DT_HAS_OVTI_OV5640_ENABLED
	default 1280
	help
	  frame width in pixels

config VIDEO_OV5640_DEFAULT_HEIGHT
	int "OV5640 default frame height in pixels"
	depends on DT_HAS_OVTI_OV5640_ENABLED
	default 720
	help
	  frame height in pixels

config VIDEO_OV5640_DEFAULT_PITCH
	int "OV5640 default pitch"
	depends on DT_HAS_OVTI_OV5640_ENABLED
	default 2560
	help
	  line stride
```

## drivers/video/Kconfig.ov7725
```kconfig
# OV7725

# Copyright (c) 2020 FrankLi Limited
# SPDX-License-Identifier: Apache-2.0

config VIDEO_OV7725
	bool "OV7725 CMOS digital image sensor"
	select I2C
	depends on DT_HAS_OVTI_OV7725_ENABLED
	default y
	help
	  Enable driver for OV7725 CMOS digital image sensor device.

config VIDEO_OV7725_DEFAULT_WIDTH
	int "OV7725 default frame width in pixels"
	depends on DT_HAS_OVTI_OV7725_ENABLED
	default 640
	help
	  frame width in pixels

config VIDEO_OV7725_DEFAULT_HEIGHT
	int "OV7725 default frame height in pixels"
	depends on DT_HAS_OVTI_OV7725_ENABLED
	default 480
	help
	  frame height in pixels

config VIDEO_OV7725_DEFAULT_PITCH
	int "OV7725 default pitch"
	depends on DT_HAS_OVTI_OV7725_ENABLED
	default 1280
	help
	  line stride
```
